## configs/imx6ullevk_defconfig
```kconfig
BR2_arm=y
BR2_cortex_a7=y
BR2_ARM_FPU_NEON_VFPV4=y
BR2_PACKAGE_HOST_LINUX_HEADERS_CUSTOM_6_12=y
BR2_PACKAGE_GLIBC_UTILS=y
BR2_GCC_VERSION_14_X=y
BR2_TOOLCHAIN_BUILDROOT_CXX=y
BR2_PACKAGE_HOST_GDB=y
BR2_PACKAGE_HOST_GDB_TUI=y
BR2_PACKAGE_HOST_GDB_PYTHON3=y
BR2_ROOTFS_DEVICE_CREATION_DYNAMIC_EUDEV=y
BR2_TARGET_GENERIC_GETTY_PORT="ttymxc0"
BR2_ROOTFS_POST_IMAGE_SCRIPT="board/freescale/common/imx/post-image.sh"
BR2_LINUX_KERNEL=y
BR2_LINUX_KERNEL_CUSTOM_GIT=y
BR2_LINUX_KERNEL_CUSTOM_REPO_URL="git@github.com:wanguo99/linux-6.12.git"
BR2_LINUX_KERNEL_CUSTOM_REPO_VERSION="master"
BR2_LINUX_KERNEL_DEFCONFIG="imx_v6_v7"
BR2_LINUX_KERNEL_DTS_SUPPORT=y
BR2_LINUX_KERNEL_INTREE_DTS_NAME="nxp/imx/imx6ull-14x14-evk"
BR2_LINUX_KERNEL_NEEDS_HOST_OPENSSL=y
BR2_PACKAGE_EVTEST=y
BR2_PACKAGE_FREESCALE_IMX=y
BR2_PACKAGE_FREESCALE_IMX_PLATFORM_IMX6UL=y
BR2_PACKAGE_FIRMWARE_IMX=y
BR2_PACKAGE_LIBV4L=y
BR2_PACKAGE_LIBV4L_UTILS=y
BR2_PACKAGE_UTIL_LINUX_AGETTY=y
BR2_TARGET_ROOTFS_EXT2=y
BR2_TARGET_ROOTFS_EXT2_4=y
BR2_TARGET_UBOOT=y
BR2_TARGET_UBOOT_BOARDNAME="mx6ull_14x14_evk"
BR2_TARGET_UBOOT_CUSTOM_GIT=y
BR2_TARGET_UBOOT_CUSTOM_REPO_URL="git@github.com:wanguo99/u-boot-v2024.10.git"
BR2_TARGET_UBOOT_CUSTOM_REPO_VERSION="master"
BR2_TARGET_UBOOT_NEEDS_DTC=y
BR2_TARGET_UBOOT_NEEDS_OPENSSL=y
BR2_TARGET_UBOOT_FORMAT_DTB_IMX=y
BR2_PACKAGE_HOST_DOSFSTOOLS=y
BR2_PACKAGE_HOST_GENIMAGE=y
BR2_PACKAGE_HOST_MTOOLS=y
```

## package/bsp/Config.in
```kconfig
config BR2_PACKAGE_BSP
	bool "BSP"
	depends on BR2_PACKAGE_OSA 
	help
		Board Support Package Module.
```

## package/cfg/Config.in
```kconfig
config BR2_PACKAGE_CFG
	bool "CFG"
	depends on BR2_PACKAGE_OSA
	help
		Product Config Module.

config BR2_PACKAGE_CFG_VERSION
	string "cfg version"
	default "1.0.0"
	depends on BR2_PACKAGE_CFG
	help
		Specify the version of the cfg kernel module.
```

## package/hal/Config.in
```kconfig
config BR2_PACKAGE_HAL
	bool "HAL"
	depends on BR2_PACKAGE_OSA
	help
		Hardware Abstraction Layer Module.

config BR2_PACKAGE_HAL_VERSION
	string "hal version"
	default "1.0.0"
	depends on BR2_PACKAGE_HAL
	help
		Specify the version of the hal kernel module.
```

## package/libpdm/Config.in
```kconfig
config BR2_PACKAGE_LIBPDM
	bool "PDM Library"
	depends on BR2_PACKAGE_PDM
	help
	  Enable PDM Library.
	  PDM is a driver module that integrates with the Linux kernel.

comment "PDM requires pdm driver to be built"
	depends on !BR2_PACKAGE_PDM

if BR2_PACKAGE_LIBPDM

choice
	prompt "PDM library version"

config BR2_PACKAGE_LIBPDM_CUSTOM_LOCAL_DIRECTORY
	bool "Custom local directory"
	help
		build pdm from local directory

config BR2_PACKAGE_LIBPDM_CUSTOM_GIT
	bool "Custom Git repository"
	help
		code from a Git repository

config BR2_PACKAGE_LIBPDM_CUSTOM_SVN
	bool "Custom Subversion repository"
	help
		code from a Subversion repository

endchoice

if BR2_PACKAGE_LIBPDM_CUSTOM_GIT || BR2_PACKAGE_LIBPDM_CUSTOM_SVN

config BR2_PACKAGE_LIBPDM_CUSTOM_REPO_URL
    string "URL of custom repository"

config BR2_PACKAGE_LIBPDM_CUSTOM_REPO_VERSION
    string "Custom repository version"
    help
      Revision to use in the typical format used by
      Git/Subversion E.G. a sha id, a tag, branch, ..

endif

config BR2_PACKAGE_LIBPDM_VERSION
    string
	default "local" if BR2_PACKAGE_LIBPDM_CUSTOM_LOCAL_DIRECTORY
    default BR2_PACKAGE_LIBPDM_CUSTOM_REPO_VERSION \
        if BR2_PACKAGE_LIBPDM_CUSTOM_GIT || BR2_PACKAGE_LIBPDM_CUSTOM_SVN

config BR2_PACKAGE_LIBPDM_CUSTOM_LOCAL_DIRECTORY_LOCATION
	string "URL of custom local directory"
	depends on BR2_PACKAGE_LIBPDM_CUSTOM_LOCAL_DIRECTORY

endif
```

## package/lws_server/Config.in
```kconfig
config BR2_PACKAGE_LWS_SERVER
	bool "Libwebsockets Server"
	select BR2_PACKAGE_LIBWEBSOCKETS
	select BR2_PACKAGE_CJSON
	help
	  Enable Libwebsockets Server.

if BR2_PACKAGE_LWS_SERVER

config BR2_PACKAGE_LWS_SERVER_VERSION
    string
	default "local"

config BR2_PACKAGE_LWS_SERVER_CUSTOM_LOCAL_DIRECTORY_LOCATION
	string "URL of custom local directory"
	default "$(TOPDIR)/package/lws_server/lws_server"
endif
```

## package/osa/Config.in
```kconfig
config BR2_PACKAGE_OSA
	bool "OSA"
	default y
	help
		Enable The Operation System Adaptor Module.

config BR2_PACKAGE_OSA_VERSION
	string "osa version"
	default "1.0.0"
	depends on BR2_PACKAGE_OSA
	help
		Specify the version of the osa kernel module.
```

## package/pconfig/Config.in
```kconfig
config BR2_PACKAGE_PCONFIG
	bool "PCONFIG"
	depends on BR2_PACKAGE_OSA
	help
		Product Config Module.

config BR2_PACKAGE_PCONFIG_VERSION
	string "pconfig version"
	default "0.0.1"
	depends on BR2_PACKAGE_PCONFIG
	help
		Specify the version of the pconfig kernel module.
```

## package/pdl/Config.in
```kconfig
config BR2_PACKAGE_PDL
	bool "PDL"
	depends on BR2_PACKAGE_OSA && BR2_PACKAGE_HAL && BR2_PACKAGE_CFG
	help
		Peripheral Driver Library Module.

config BR2_PACKAGE_PDL_VERSION
	string "pdl version"
	default "1.0.0"
	depends on BR2_PACKAGE_PDL
	help
		Specify the version of the pdl kernel module.
```

## package/pdm/Config.in
```kconfig
config BR2_PACKAGE_PDM
	bool "PDM (Peripheral Driver Module)"
	depends on BR2_LINUX_KERNEL
	help
	  Enable this option to include the Peripheral Driver Module (PDM).
	  PDM is a driver module that integrates with the Linux kernel.

comment "PDM requires a Linux kernel to be built"
	depends on !BR2_LINUX_KERNEL

if BR2_PACKAGE_PDM

choice
	prompt "PDM version"

config BR2_PACKAGE_PDM_CUSTOM_LOCAL_DIRECTORY
	bool "Custom local directory"
	help
		build pdm from local directory

config BR2_PACKAGE_PDM_CUSTOM_GIT
	bool "Custom Git repository"
	help
		code from a Git repository

config BR2_PACKAGE_PDM_CUSTOM_SVN
	bool "Custom Subversion repository"
	help
		code from a Subversion repository

endchoice

if BR2_PACKAGE_PDM_CUSTOM_GIT || BR2_PACKAGE_PDM_CUSTOM_SVN

config BR2_PACKAGE_PDM_CUSTOM_REPO_URL
    string "URL of custom repository"

config BR2_PACKAGE_PDM_CUSTOM_REPO_VERSION
    string "Custom repository version"
    help
      Revision to use in the typical format used by
      Git/Subversion E.G. a sha id, a tag, branch, ..

endif

config BR2_PACKAGE_PDM_VERSION
    string
	default "local" if BR2_PACKAGE_PDM_CUSTOM_LOCAL_DIRECTORY
    default BR2_PACKAGE_PDM_CUSTOM_REPO_VERSION \
        if BR2_PACKAGE_PDM_CUSTOM_GIT || BR2_PACKAGE_PDM_CUSTOM_SVN

config BR2_PACKAGE_PDM_CUSTOM_LOCAL_DIRECTORY_LOCATION
	string "URL of custom local directory"
	depends on BR2_PACKAGE_PDM_CUSTOM_LOCAL_DIRECTORY

endif
```

## package/wgtool/Config.in
```kconfig
config BR2_PACKAGE_WGTOOL
	bool "WGTOOL"
	depends on BR2_PACKAGE_OSA
	help
		wanguo test app.

config BR2_PACKAGE_WGTOOL_VERSION
	string "wgtool version"
	default "1.0.0"
	depends on BR2_PACKAGE_WGTOOL
	help
		Specify the version of the wgtool app.
```
